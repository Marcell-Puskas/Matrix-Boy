#include <Adafruit_GFX.h>
#include <Adafruit_NeoMatrix.h>
#include <Adafruit_NeoPixel.h>

const int matrixWidth = 8;
const int matrixHeight = 8;
const int tilesX = 1;
const int tilesY = 2;
const int pin = 6;
const int matrixType = NEO_TILE_TOP;
const int ledType = NEO_GRB;

Adafruit_NeoMatrix matrix = Adafruit_NeoMatrix(
    matrixWidth, matrixHeight, tilesX, tilesY, pin, matrixType, ledType);

#define joy_x_pin A0;
#define joy_y_pin A1;
#define joy_button_pin 9;

int joy_x = 0;
int joy_y = 0;
int joy_button = 0;
//static const 
const uint16_t snake_bmp[] PROGMEM = {
    0x001f, 0x001f, 0x001f, 0x001f, 0x001f, 0x001f, 0x001f, 0x001f, 
    0x001f, 0x0000, 0x0000, 0x0000, 0x0000, 0x0000, 0x0000, 0x001f, 
    0x001f, 0x0000, 0x0000, 0x0000, 0x0000, 0x0000, 0x0000, 0x001f, 
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    0x001f, 0x001f, 0x001f, 0x001f, 0x001f, 0x001f, 0x001f, 0x001f
};

const uint16_t tetris_bmp[] PROGMEM = {
    0xffff, 0xffff, 0xffff, 0xffff, 0xffff, 0xffff, 0xffff, 0xffff, 
    0xffff, 0x0000, 0x0000, 0x0000, 0x0000, 0x0000, 0x0000, 0xffff, 
    0xffff, 0x0000, 0x0000, 0x0000, 0x07ff, 0x0000, 0x0000, 0xffff, 
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    0xffff, 0xffff, 0xffff, 0xffff, 0xffff, 0xffff, 0xffff, 0xffff
};

const String games[] = {
    "snake",
    "tetris"
};

const uint16_t *bmps[] = {
    snake_bmp,
    tetris_bmp
};

const int game_count = 2;
const int anim_speed = 25;
char keychar;
int selected = 0;

void call_game(int game_index) {
    switch (game_index)
    {
        case 0:
            
        break;
    }
}

void setup() {
    pinMode(6, OUTPUT);

    matrix.begin();
    matrix.setBrightness(1);
    Serial.begin(9600);
}

void loop() {
    if(Serial.available())
    {
        keychar = Serial.read();

        Serial.println("Reading serial");
    }

    switch (keychar)
    {
        case 'a':
        if(selected > 0)
        {
            selected--;
            for (size_t i = 0; i < matrixWidth; i++)
            {
                matrix.drawRGBBitmap(i, 0, (bmps[selected+1]), 8, 16);
                matrix.drawRGBBitmap(-matrixWidth+i, 0, (bmps[selected]), 8, 16);
                matrix.show();
                delay(anim_speed);
            }
        }
        break;

        case 'd':
        if(selected + 1 < game_count)
        {
            selected++;
            for (size_t i = 0; i < matrixWidth; i++)
            {
                matrix.drawRGBBitmap(-i, 0, (bmps[selected-1]), 8, 16);
                matrix.drawRGBBitmap(matrixWidth-i, 0, (bmps[selected]), 8, 16);
                matrix.show();
                delay(anim_speed);
            }
        }
        break;

        case 'o':
        call_game(selected);
        break;
    }

    keychar = NULL;

    matrix.drawRGBBitmap(0, 0, (bmps[selected]), 8, 16);
    Serial.println(games[selected]);
    Serial.print("btn: ");
    Serial.println(joy_button);
    matrix.show();

    //for (size_t i = 0; i < 5; i++)
    {
        joy_x = analogRead(A0);
        joy_y = analogRead(A1);
        joy_button = digitalRead(9);

        if(joy_x > 640) keychar = 'd';
        if(joy_x < 384) keychar = 'a';
        if(joy_button == 0) keychar = 'o';

        delay(10);
    }
}
